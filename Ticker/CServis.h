///////////////////////////////////
// Jadro Tickeru v1.2
// * 07/2018
// 
////////////////////////

// LCD, vytvoreni objektu pro praci s displejem
// SSD1306
// 128x64
// I2C = 4pinovy displej, GND,VCC,SCL,SDA
// Hodnoty SCL(clock) a SDA(data) lze menit za cisla pinu, napr D3 a D4
U8G2_SSD1306_128X64_NONAME_F_SW_I2C u8g2(U8G2_R0, /* clock=*/ SCL, /* data=*/ SDA, /* reset=*/ U8X8_PIN_NONE);

// Struktura kryptomeny
typedef struct __Coin
{
  // Mezinarodni zkratka (symbol) meny, 
  // napr.: "BTC"
  String ID;
  // Cena za kryptomenu v penezich dle API (napr. USD)
  float Price;
  // Historie meny od nejnizsiho casoveho obdobi, 
  // napr.: 0=hodina,1=den,2=vikend  
  float History[3]; 
}Coin;


#define welcome_width 128
#define welcome_height 64
static unsigned char welcome_bits[] = {
  0x00, 0x00, 0x00, 0x00, 0x00, 0x00, 0x00, 0x00, 0x00, 0x00, 0x00, 0x00, 
  0x00, 0x00, 0x00, 0x00, 0x00, 0x00, 0x00, 0x00, 0x00, 0x00, 0x00, 0x00, 
  0x00, 0x00, 0x00, 0x00, 0x00, 0x00, 0x00, 0x00, 0x00, 0x00, 0x00, 0x00, 
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  0x00, 0x00, 0x00, 0x00, };



#define intro_width 128
#define intro_height 64
static unsigned char intro_bits[] = {
   0x00, 0x00, 0x00, 0x00, 0x00, 0x00, 0x00, 0x00, 0x00, 0x00, 0x00, 0x00,
   0x00, 0x00, 0x00, 0x00, 0x00, 0x00, 0x00, 0x00, 0x00, 0x00, 0x00, 0x00,
   0x00, 0x00, 0x00, 0x00, 0x00, 0x00, 0x00, 0x00, 0x00, 0x00, 0x00, 0x00,
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   0x00, 0x00, 0x00, 0x00 };

#define coin01_width 35
#define coin01_height 35
static unsigned char coin01_bits[] = {
   0x00, 0xc0, 0x1f, 0x00, 0x00, 0x00, 0xf8, 0xff, 0x00, 0x00, 0x00, 0xfe,
   0xff, 0x03, 0x00, 0x80, 0xff, 0xff, 0x0f, 0x00, 0xc0, 0xff, 0xff, 0x1f,
   0x00, 0xe0, 0x3f, 0xe0, 0x3f, 0x00, 0xf0, 0x0f, 0x80, 0x7f, 0x00, 0xf8,
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   0x00, 0x00, 0x00, 0xc0, 0x1f, 0x00, 0x00 };


#define coin02_width 35
#define coin02_height 35
static unsigned char coin02_bits[] = {
   0x00, 0xc0, 0x0f, 0x00, 0x00, 0x00, 0xf0, 0x7f, 0x00, 0x00, 0x00, 0xfc,
   0xff, 0x00, 0x00, 0x00, 0xfe, 0xff, 0x03, 0x00, 0x00, 0xff, 0xff, 0x07,
   0x00, 0x80, 0x3f, 0xf0, 0x0f, 0x00, 0xc0, 0x1f, 0xc0, 0x1f, 0x00, 0xe0,
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   0x00, 0x00, 0x00, 0xc0, 0x0f, 0x00, 0x00 };


#define coin03_width 35
#define coin03_height 35
static unsigned char coin03_bits[] = {
   0x00, 0x80, 0x0f, 0x00, 0x00, 0x00, 0xe0, 0x3f, 0x00, 0x00, 0x00, 0xf0,
   0x7f, 0x00, 0x00, 0x00, 0xfc, 0xff, 0x00, 0x00, 0x00, 0xfc, 0xff, 0x01,
   0x00, 0x00, 0x7e, 0xf0, 0x03, 0x00, 0x00, 0x3f, 0xe0, 0x03, 0x00, 0x00,
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   0x00, 0x00, 0x00, 0x80, 0x0f, 0x00, 0x00 };

  

#define coin04_width 35
#define coin04_height 35
static unsigned char coin04_bits[] = {
   0x00, 0x00, 0x07, 0x00, 0x00, 0x00, 0xc0, 0x1f, 0x00, 0x00, 0x00, 0xe0,
   0x3f, 0x00, 0x00, 0x00, 0xf0, 0x7f, 0x00, 0x00, 0x00, 0xf0, 0x7f, 0x00,
   0x00, 0x00, 0xf8, 0xf8, 0x00, 0x00, 0x00, 0x78, 0xf0, 0x00, 0x00, 0x00,
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   0x00, 0x00, 0x00, 0x00, 0x07, 0x00, 0x00 };
  

#define coin05_width 35
#define coin05_height 35
static unsigned char coin05_bits[] = {
   0x00, 0x00, 0x07, 0x00, 0x00, 0x00, 0x80, 0x0f, 0x00, 0x00, 0x00, 0x80,
   0x0f, 0x00, 0x00, 0x00, 0xc0, 0x1f, 0x00, 0x00, 0x00, 0xc0, 0x1f, 0x00,
   0x00, 0x00, 0xe0, 0x38, 0x00, 0x00, 0x00, 0xe0, 0x38, 0x00, 0x00, 0x00,
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   0x00, 0x00, 0x00, 0x00, 0x07, 0x00, 0x00 };

  

#define coin06_width 35
#define coin06_height 35
static unsigned char coin06_bits[] = {
   0x00, 0x00, 0x03, 0x00, 0x00, 0x00, 0x00, 0x03, 0x00, 0x00, 0x00, 0x00,
   0x07, 0x00, 0x00, 0x00, 0x80, 0x07, 0x00, 0x00, 0x00, 0x80, 0x07, 0x00,
   0x00, 0x00, 0x80, 0x0c, 0x00, 0x00, 0x00, 0x80, 0x0c, 0x00, 0x00, 0x00,
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   0x00, 0x00, 0x00, 0x00, 0x03, 0x00, 0x00 };



#define coin07_width 35
#define coin07_height 35
static unsigned char coin07_bits[] = {
   0x00, 0x00, 0x06, 0x00, 0x00, 0x00, 0x00, 0x06, 0x00, 0x00, 0x00, 0x00,
   0x07, 0x00, 0x00, 0x00, 0x00, 0x0f, 0x00, 0x00, 0x00, 0x00, 0x0f, 0x00,
   0x00, 0x00, 0x80, 0x09, 0x00, 0x00, 0x00, 0x80, 0x09, 0x00, 0x00, 0x00,
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   0x00, 0x00, 0x00, 0x00, 0x06, 0x00, 0x00 };


#define coin08_width 35
#define coin08_height 35
static unsigned char coin08_bits[] = {
   0x00, 0x00, 0x07, 0x00, 0x00, 0x00, 0x80, 0x0f, 0x00, 0x00, 0x00, 0x80,
   0x0f, 0x00, 0x00, 0x00, 0xc0, 0x1f, 0x00, 0x00, 0x00, 0xc0, 0x1f, 0x00,
   0x00, 0x00, 0xe0, 0x38, 0x00, 0x00, 0x00, 0xe0, 0x38, 0x00, 0x00, 0x00,
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   0x00, 0x00, 0x00, 0x00, 0x07, 0x00, 0x00 };


#define coin09_width 35
#define coin09_height 35
static unsigned char coin09_bits[] = {
   0x00, 0x00, 0x07, 0x00, 0x00, 0x00, 0xc0, 0x1f, 0x00, 0x00, 0x00, 0xe0,
   0x3f, 0x00, 0x00, 0x00, 0xf0, 0x7f, 0x00, 0x00, 0x00, 0xf0, 0x7f, 0x00,
   0x00, 0x00, 0xf8, 0xf8, 0x00, 0x00, 0x00, 0x78, 0xf0, 0x00, 0x00, 0x00,
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   0x00, 0x00, 0x00, 0x00, 0x07, 0x00, 0x00 };



#define coin10_width 35
#define coin10_height 35
static unsigned char coin10_bits[] = {
   0x00, 0x80, 0x0f, 0x00, 0x00, 0x00, 0xe0, 0x3f, 0x00, 0x00, 0x00, 0xf0,
   0x7f, 0x00, 0x00, 0x00, 0xf8, 0xff, 0x01, 0x00, 0x00, 0xfc, 0xff, 0x01,
   0x00, 0x00, 0x7e, 0xf0, 0x03, 0x00, 0x00, 0x3e, 0xe0, 0x07, 0x00, 0x00,
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   0x00, 0x00, 0x00, 0x80, 0x0f, 0x00, 0x00 };


#define coin11_width 35
#define coin11_height 35
static unsigned char coin11_bits[] = {
   0x00, 0x80, 0x1f, 0x00, 0x00, 0x00, 0xf0, 0x7f, 0x00, 0x00, 0x00, 0xf8,
   0xff, 0x01, 0x00, 0x00, 0xfe, 0xff, 0x03, 0x00, 0x00, 0xff, 0xff, 0x07,
   0x00, 0x80, 0x7f, 0xe0, 0x0f, 0x00, 0xc0, 0x1f, 0xc0, 0x1f, 0x00, 0xc0,
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   0x00, 0x00, 0x00, 0x80, 0x1f, 0x00, 0x00 };
   

#define coin12_width 35
#define coin12_height 35
static unsigned char coin12_bits[] = {
   0x00, 0xc0, 0x1f, 0x00, 0x00, 0x00, 0xf8, 0xff, 0x00, 0x00, 0x00, 0xfe,
   0xff, 0x03, 0x00, 0x80, 0xff, 0xff, 0x0f, 0x00, 0xc0, 0xff, 0xff, 0x1f,
   0x00, 0xe0, 0x3f, 0xe0, 0x3f, 0x00, 0xf0, 0x0f, 0x80, 0x7f, 0x00, 0xf8,
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   0x00, 0x00, 0x00, 0xc0, 0x1f, 0x00, 0x00 };

////////////////////////////////////////////////////////////////////////////////////////////////////////
////////////////////////////////////////////////////////////////////////////////////////////////////////
// Obsluzna trida pro spravu Tickeru
class CServis
{
  public:

    // NUTNO provest inicializaci pri setupu!
    void Init( const String & wifiName, const String & passName, const String & apiURL, const String & apiURI1, const String & apiURI2, const String & apiURI3, const String & apiURI4,
                    const String & jsonCoinSymbol, const String & jsonPrice, const String & jsonHistory1, const String & jsonHistory2, const String & jsonHistory3 );
    // Mod pripojeni tickeru k wifi
    // Argument je pocet pokusu k pripojeni po sekundach
    // Vraci true v pripade uspechu
    bool ConnectMode(const int & cAttempts);
    // Nacteni dat o menach z netu
    // Vraci true v pripade uspechu
    // Argument je cislo konecne URL API, pocitane od 0 do 3
    bool ReadDataFromSite(const int & endAPI);
    // Obnoveni dat ze serveru
    // Vrati true v pripade uspechu
    bool RefreshData(void);
    // Vraci info o mene pomoci struktury Coin
    // Argument je cislo meny pocitane od nuly
    Coin GetCoinData(const int & iCoin);
    // Upravuje ciselnou podobu do pozadovaneho tvaru vcetne tisicinek a desetinnych mist
    // Vraci upraveny retezec
    String FixCoinText(const float & Price);
    // Zobrazi aktualne zvolenou menu a jeji zvolenou historii na displeji
    void ShowCoin(const int & iCoin,const int & iHistory);
    // Zobrazi dialog s hlasenim
    // Argument iconID je cislo ikony z nasledujiciho odkazu: 
    // https://github.com/olikraus/u8g2/wiki/fntgrpiconic#open_iconic_all_2x
    // textUp=Prvni radek textu
    // textDown=Druhy radek textu
    void ShowDialogInfo(const int & iconID, const String & textUp, const String & textDown );
    // Zobrazi ikonu na displej v horni casti, bez smazani displeje
    // Side ma 3 moznosti zobrazeni ikony>  0=vlevo, 1=stred, 2=vpravo
    void ShowIcon(const int & iconID, const int & Side );
    void ShowIntro();

  private:

    void EraseBit( const int & X, const int & Y, const int & Width, const int & Height );

    // Nazev a heslo WiFi pro ziskavani dat
    String    __ssidWifi;
    String    __passWifi;

    // URL adresa API
    String    __API;
    // Konecna URL kryptomen vcetne lomitek (__API+__EndAPI=cela URL pro ziskani dat)
    String    __EndAPI[4];
    // Informace o kryptomenach, nacitaji se automaticky z API
    Coin      __sCoin[4];

    // JSON znacky pro nacitani dat z API
    String    __Symbol;
    String    __Price;
    String    __HHour;
    String    __HDay;
    String    __HWeek;

};


void CServis::EraseBit( const int & X, const int & Y, const int & Width, const int & Height )
{
  u8g2.setDrawColor(1);
  u8g2.drawBox( X, Y, Width, Height );
  u8g2.setDrawColor(1);
}


void CServis::ShowIntro()
{
  int delayPict = 5;
  int X = (128/2)-(35/2);
  int Y = (64/2)-(35/2);
  u8g2.drawXBM( 0, 0, welcome_width, welcome_height, welcome_bits);
  u8g2.sendBuffer();
  delay(2000);
  u8g2.drawXBM( 0, 0, intro_width, intro_height, intro_bits);
  u8g2.sendBuffer();
  delay(delayPict);
  u8g2.drawXBM( X, Y, coin01_width, coin01_height, coin01_bits);
  u8g2.sendBuffer();
  delay(delayPict);
  EraseBit(X,Y,35,35);
  u8g2.drawXBM( X, Y, coin02_width, coin02_height, coin02_bits);
  u8g2.sendBuffer();
  delay(delayPict);
  EraseBit(X,Y,35,35);
  u8g2.drawXBM( X, Y, coin03_width, coin03_height, coin03_bits);
  u8g2.sendBuffer();
  delay(delayPict);
  EraseBit(X,Y,35,35);
  u8g2.drawXBM( X, Y, coin04_width, coin04_height, coin04_bits);
  u8g2.sendBuffer();
  delay(delayPict);
  EraseBit(X,Y,35,35);
  u8g2.drawXBM( X, Y, coin05_width, coin05_height, coin05_bits);
  u8g2.sendBuffer();
  delay(delayPict);
  EraseBit(X,Y,35,35);
  u8g2.drawXBM( X, Y, coin06_width, coin06_height, coin06_bits);
  u8g2.sendBuffer();
  delay(delayPict);
  EraseBit(X,Y,35,35);
  u8g2.drawXBM( X, Y, coin07_width, coin07_height, coin07_bits);
  u8g2.sendBuffer();
  delay(delayPict);
  EraseBit(X,Y,35,35);
  u8g2.drawXBM( X, Y, coin08_width, coin08_height, coin08_bits);
  u8g2.sendBuffer();
  delay(delayPict);
  EraseBit(X,Y,35,35);
  u8g2.drawXBM( X, Y, coin09_width, coin09_height, coin09_bits);
  u8g2.sendBuffer();
  delay(delayPict);
  EraseBit(X,Y,35,35);
  u8g2.drawXBM( X, Y, coin10_width, coin10_height, coin10_bits);
  u8g2.sendBuffer();
  delay(delayPict);
  EraseBit(X,Y,35,35);
  u8g2.drawXBM( X, Y, coin11_width, coin11_height, coin11_bits);
  u8g2.sendBuffer();
  delay(delayPict);
  EraseBit(X,Y,35,35);
  u8g2.drawXBM( X, Y, coin12_width, coin12_height, coin12_bits);
  u8g2.sendBuffer();
}


void CServis::ShowIcon(const int & iconID, const int & Side )
{
  int Width = u8g2.getDisplayWidth();
  int Height = u8g2.getDisplayHeight();
  u8g2.setFont(u8g2_font_open_iconic_all_2x_t);
  int charWidth = u8g2.getMaxCharWidth();
  u8g2.setFontPosTop();
  switch(Side)
  {
    case 0:
    {
      u8g2.drawGlyph(0,0,iconID);
      break;
    }
    case 1:
    {
      u8g2.drawGlyph((Width/2)-(charWidth/2),0,iconID);
      break;
    }
    case 2:
    {
      u8g2.drawGlyph((Width-charWidth),0,iconID);
      break;
    }
  }
  u8g2.sendBuffer();
}

void CServis::ShowDialogInfo(const int & iconID, const String & textUp, const String & textDown )
{
  int Width = u8g2.getDisplayWidth();
  int Height = u8g2.getDisplayHeight();
  u8g2.setFontMode(1);
  u8g2.setDrawColor(0);
  u8g2.drawBox(0,0,Width,Height);
  u8g2.setDrawColor(1);
  u8g2.setFont(u8g2_font_open_iconic_all_2x_t);
  u8g2.setFontPosTop();
  u8g2.drawGlyph((Width/2)-(u8g2.getMaxCharWidth()/2),0,iconID );
  ////
  u8g2.setFont(u8g2_font_shylock_nbp_tf);
  int Max = u8g2.getMaxCharHeight();
  int WidthTextUp = u8g2.getStrWidth(textUp.c_str());
  int WidthTextDown = u8g2.getStrWidth(textDown.c_str());
  u8g2.drawStr((Width/2)-(WidthTextUp/2),(20+Max/2),textUp.c_str());
  u8g2.drawStr((Width/2)-(WidthTextDown/2),(40+Max/2),textDown.c_str());
  u8g2.sendBuffer();
}


Coin CServis::GetCoinData(const int & iCoin)
{
  return __sCoin[iCoin];      
}


String CServis::FixCoinText(const float & Price)
{
  String fixString = "";
  // Prevod meny i s desetinnou carkou na text
  String conString = (String)Price;
  // Touto promennou zajistime prevod z float do int, 
  // tedy prevod na cele cislo
  int dNum = Price;
  // A toto cele cislo prevedeme na text
  String dString = (String)dNum;
  // Zde se vytahneme pouze tu cast cisla za desetinnou carkou
  // Diky tomu pak muzu zjistit pocet desetinnych mist
  String decString = conString.substring(conString.indexOf(".")+1);
  // Tu jde hlavne o to, srovnat pocet desetinnych mist na 2
  // V dalsi casti teto fce se uz bude jen snizovat dle potreby.
  switch( decString.length() )
  {
    case 0:
    {
      decString += "00";
      break;
    }
    case 1:
    {
      decString += "0";
      break;
    }
  }
  // Kdyby snad nahodou bylo desetinnych mist vic jak 2, skrouhni to na 2
  if ( decString.length() > 2 )
  {
    decString = decString.substring(0,2);
  }
  // A zde se uz prideluji tisicinne tecky a desetinne mista dle potreby i v minusovych hodnotach
  ////////////////////////////
  if ( dNum >= 0 && dNum < 10 )
  {
    fixString += (String)dNum;
    fixString += ",";
    fixString += decString;
    //Serial.println("0-9");      
  }
  if ( dNum < 0 && dNum > -10 )
  {
    fixString += (String)dNum;
    fixString += ",";
    fixString += decString;
    //Serial.println("0-9");      
  }
  if ( dNum >= 10 && dNum < 100 )
  {
    fixString += (String)dNum;
    fixString += ",";
    fixString += decString;
    //Serial.println("10-99");      
  }
  if ( dNum <= -10 && dNum > -100 )
  {
    fixString += (String)dNum;
    fixString += ",";
    fixString += decString;
    //Serial.println("10-99");      
  }
  if ( dNum >= 100 && dNum < 1000 )
  {
    fixString += (String)dNum;
    fixString += ",";
    fixString += decString.substring(0,1);
    //Serial.println("100-999");      
  }
  if ( dNum <= -100 && dNum > -1000 )
  {
    fixString += (String)dNum;
    fixString += ",";
    fixString += decString.substring(0,1);
    //Serial.println("100-999");      
  }
  if ( dNum >= 1000 && dNum < 10000 )
  {
    fixString += dString.substring(0,1);
    fixString += ".";
    fixString += dString.substring(1);
    //Serial.println("1.000-9.999");      
  }
  if ( dNum <= -1000 && dNum > -10000 )
  {
    fixString += dString.substring(0,2);
    fixString += ".";
    fixString += dString.substring(2);
    //Serial.println("1.000-9.999");      
  }
  if ( dNum >= 10000 && dNum < 100000 )
  {
    fixString += dString.substring(0,2);
    fixString += ".";
    fixString += dString.substring(2);
    //Serial.println("10.000-99.000");      
  }
  if ( dNum <= -10000 && dNum > -100000 )
  {
    fixString += dString.substring(0,3);
    fixString += ".";
    fixString += dString.substring(3);
    //Serial.println("10.000-99.000");      
  }
  if ( dNum > 100000 && dNum < 1000000 )
  {
    fixString += dString.substring(0,3);
    fixString += ".";
    fixString += dString.substring(3);
    //Serial.println("100.000-999.999");      
  }
  if ( dNum <= -100000 && dNum > -1000000 )
  {
    fixString += dString.substring(0,4);
    fixString += ".";
    fixString += dString.substring(4);
    //Serial.println("100.000-999.999");      
  }
  if ( dNum >= 1000000 )
  {
    fixString += dString.substring(0,1);
    fixString += ".";
    fixString += dString.substring(1,4);
    fixString += ".";
    fixString += dString.substring(4);
    //Serial.println(">1.000.000");   
  }
  if ( dNum <= -1000000 )
  {
    fixString += dString.substring(0,2);
    fixString += ".";
    fixString += dString.substring(2,5);
    fixString += ".";
    fixString += dString.substring(5);
    //Serial.println(">1.000.000");   
  }
  return fixString;
}

void CServis::ShowCoin(const int & iCoin,const int & iHistory)
{
  //u8g2.clear();

  int Width = u8g2.getDisplayWidth();
  int Height = u8g2.getDisplayHeight();

  u8g2.setFontMode(1);

  u8g2.setFontPosCenter();
  u8g2.setFont(SYMBOL_FONT_NAME);

  u8g2.setDrawColor(0);
  int iMaxHeightA = u8g2.getMaxCharHeight();
  u8g2.drawBox( 0, 0, Width, iMaxHeightA );
  u8g2.setDrawColor(1);
  u8g2.drawStr( (Width/2)-(u8g2.getStrWidth(__sCoin[iCoin].ID.c_str() )/2), (iMaxHeightA/2), __sCoin[iCoin].ID.c_str() );

  u8g2.setFont(COIN_FONT_NAME);
  String chPrice = FixCoinText(__sCoin[iCoin].Price);
  String chPrefix = PREFIX_PRICE;
  String chPostfix = POSTFIX_PRICE;
  String chShowPrice = "";
  chShowPrice += chPrefix;
  chShowPrice += chPrice;
  chShowPrice += chPostfix;
  
  u8g2.setDrawColor(0);
  int iMaxHeightB = u8g2.getMaxCharHeight();
  u8g2.drawBox( 0, iMaxHeightA, Width, iMaxHeightB );
  u8g2.setDrawColor(1);
  u8g2.drawStr( (Width/2)-(u8g2.getStrWidth(chShowPrice.c_str() )/2), (iMaxHeightA+(iMaxHeightB/2))+1, chShowPrice.c_str() );

  u8g2.setFont(HISTORY_FONT_NAME);
  String chHistory = FixCoinText(__sCoin[iCoin].History[iHistory]);
  String chHPrefix = "";
  if ( (int)__sCoin[iCoin].History[iHistory] >= 0 )
  {
    chHPrefix = "+";
  }
  String chHPostfix = "";
  if ( iHistory == 0 )
  {
    chHPostfix = HISTORY1;     
  }
  if ( iHistory == 1)
  {
    chHPostfix = HISTORY2;     
  }
  if ( iHistory == 2 )
  {
    chHPostfix = HISTORY3;     
  }
  String chShowHistory = "";
  chShowHistory += chHPrefix;
  chShowHistory += chHistory;
  chShowHistory += chHPostfix;

  u8g2.setDrawColor(0);
  int iMaxHeightC = u8g2.getMaxCharHeight();
  u8g2.drawBox( 0, iMaxHeightA+iMaxHeightB, Width, Height-(iMaxHeightA+iMaxHeightB) );
  u8g2.setDrawColor(1);
  u8g2.drawStr( (Width/2)-(u8g2.getStrWidth(chShowHistory.c_str() )/2), iMaxHeightA+iMaxHeightB+(iMaxHeightC/2), chShowHistory.c_str() );
  
  u8g2.sendBuffer();
}

bool CServis::ReadDataFromSite(const int & endAPI)
{
  // Staticke pocitadlo poruch spojeni
  static int nBad = 0;
  // Pomocna promenna pro ulozeni nactene stranky z netu
  String payload;
  // Vytvoreni SSL klienta pro komunikaci se serverem
  // Zabezpecene pripojeni je vetsinou vyzadovano serverem
  WiFiClientSecure client;
  // V pripade ze se na server nelze pripojit, konci neuspechem
  if (!client.connect(__API, 443)) 
  {
    nBad++;
    Serial.print("[cli.connect() failed]");
    // Pokud pri obnove vypadne spojeni (neni wifi,neni internet), inkrementuj pocitadlo
    // a pri prekroceni poctu 5 pokusu o spojeni zobraz ikonku poruchy! 
    if ( nBad >= 10 )
    {
      nBad = 0; // za dalsich 5 poruch se uvidime..:]
      //ShowIcon(87,0); // ukaz ikonu poruchy
      ShowIcon(121,0);
    }
    delay(1000);
    return false;
  }
  // Posleme pozadavek na server pro ziskani dat
  client.print(String("GET ") + __EndAPI[endAPI] + " HTTP/1.1\r\n" +
               "Host: " + __API + "\r\n" +
               "Connection: close\r\n\r\n");
  // Pauza pro server na zpracovani pozadavku
  delay(100);
  // Uvolnime pamet pozadavku na server
  client.flush();
  // Zjisti velikost dat pro prijem
  // Pokud data nejsou, konec a opakovat
  int sizeServerData = client.available();
  if ( sizeServerData <= 0 )
  {
    Serial.print("[Data failed]");
    return false;
  }
  // Alokace bufferu pro data
  char *bufferServerData = (char*)malloc(sizeof(char)*2048);
  // inicializace alokovane pameti
  memset( bufferServerData, 0, 2048 );
  // A ZDE data jednoduse nacteme
  client.readBytes(bufferServerData,sizeServerData);
  // A predame do bufferu pro JSON parsing
  payload = bufferServerData;
  // Uvolnime naalokovanou pamet
  free(bufferServerData);
  // Oznackujeme si json dle hranatych zavorek
  int indexLeft = payload.indexOf("[");
  int indexRight = payload.indexOf("]",indexLeft );
  // Nyni uz provedeme vytazek cisteho JSONu
  payload = payload.substring( indexLeft, indexRight+1 );

  // Vypocet velikost bufferu + 380 bajtu pro duplikaty
  const size_t bufferSize = JSON_ARRAY_SIZE(1) + JSON_OBJECT_SIZE(15) + 380;
  // Definice dynamickeho (automatickeho) bufferu
  DynamicJsonBuffer jsonBuffer(bufferSize);
  // Sprasujeme JSON z pomocne promenne
  JsonArray& root = jsonBuffer.parseArray(payload.c_str());
  // Otestujeme spravnost JSONu
  // V pripade neuspechu koncime
  if (!root.success()) 
  {
    Serial.print("[root.succes() failed]");
    return false;
  }  
  JsonObject& root_0 = root[0];
  // Nyni uz si roztridime jednotlive polozky do promennych  
  __sCoin[endAPI].ID = root_0.get<String>(__Symbol);
  __sCoin[endAPI].Price = root_0.get<float>(__Price);
  __sCoin[endAPI].History[0] = root_0.get<float>(__HHour);
  __sCoin[endAPI].History[1] = root_0.get<float>(__HDay);
  __sCoin[endAPI].History[2] = root_0.get<float>(__HWeek);
  // Staticke pocitadlo poruch pri spojeni vratime zpet na 0
  nBad = 0;
  // Koncime uspechem :)
  return true;
}


bool CServis::ConnectMode(const int & cAttempts)
{
  // Prepnuti tickeru do modu station
  WiFi.mode(WIFI_STA);
  // Vypis informaci o wifi na konzolu
  Serial.println("* Ticker switched to WIFI_STA");
  Serial.print("* Start connecting to wifi: ");
  Serial.print(__ssidWifi);
  Serial.print(" [");
  Serial.print(__passWifi);
  Serial.println("]");
  Serial.print("* Connecting.");
  // Pocitadlo neuspechu
  int cLoop = 0;
  // Zahajeni spojeni
  WiFi.begin(__ssidWifi.c_str(),__passWifi.c_str());
  // Pockame na spojeni s wifi s kontrolou neuspechu
  // Pokud spojeni neprobehne ve stanovenem poctu pokusu, ukonci smycku
  while (WiFi.status() != WL_CONNECTED) 
  { 
    delay(500);
    Serial.print(".");
    cLoop++;
    if ( cLoop >= cAttempts )
    {
      return false;
    }
  }
  // Po navazani spojeni vypis info do konzoly  
  Serial.println("OK!");
  Serial.println("* Attempt to first reading data from the server.");
  // A nyni jiz proved prvni nacteni dat ze serveru
  // Pred touto operaci zobraz info na displej
  ShowDialogInfo(204/*123*/,TEXT7,TEXT8);
  delay(1000);
  for ( int i = 0; i < 4; i++ )
  {
    Serial.print("* Reading data ");
    Serial.print(i);
    Serial.print(".");
    while( !ReadDataFromSite(i) )
    {
      Serial.print(".");
      delay(500);
    }
    Serial.println("OK");
  }
  return true;
}

// Tato fce by nemela do budoucna mit info o neuspechu na displej
// Casto se stava ze data nejsou nactena na poprve, obtezovalo by to
bool CServis::RefreshData(void)
{
  for ( int i = 0; i < 4; i++ )
  {
    Serial.print("* Reading data ");
    Serial.print(i);
    Serial.print(".");
    // Provadej nacteni dat dokud nebude vse OK
    while( !ReadDataFromSite(i) )
    {
      Serial.print(".");
    }
    Serial.println("OK");
  }
  return true; 
}


void CServis::Init( const String & wifiName, const String & passName, const String & apiURL, const String & apiURI1, const String & apiURI2, const String & apiURI3, const String & apiURI4,
                    const String & jsonCoinSymbol, const String & jsonPrice, const String & jsonHistory1, const String & jsonHistory2, const String & jsonHistory3 )
{
  __ssidWifi = wifiName;
  __passWifi = passName;

  __API = apiURL;
  
  __EndAPI[0] = apiURI1;
  __EndAPI[1] = apiURI2;
  __EndAPI[2] = apiURI3;
  __EndAPI[3] = apiURI4;

  __Symbol  = jsonCoinSymbol;
  __Price   = jsonPrice;
  __HHour   = jsonHistory1;
  __HDay    = jsonHistory2;
  __HWeek   = jsonHistory3;
  
  __sCoin[0].ID = "";
  __sCoin[1].ID = "";
  __sCoin[2].ID = "";
  __sCoin[3].ID = "";

  for ( int i = 0; i < 4; i++ )
  {
    for (int j = 0; j < 3; j++ )
    {
      __sCoin[i].History[j] = 0;
    }
  }

  u8g2.begin();  
  u8g2.clear();
};


/////////////////////////////////////////////////////////////
/////////////////////////////////////////////////////////////
